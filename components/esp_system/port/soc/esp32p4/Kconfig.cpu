## components/esp_system/port/soc/esp32p4/Kconfig.cpu
```kconfig
config ESP_FORCE_400MHZ_ON_REV_LESS_V3
    bool "Force 400MHz on revision < 3.0 (EXPERIMENTAL)"
    depends on ESP32P4_SELECTS_REV_LESS_V3
    default n
    help
        Running at 400MHz on ESP32-P4 revision < 3.0 requires chips that have
        passed additional qualification. Enable this option only if you have
        confirmed with Espressif that your specific chips are qualified for
        400MHz operation. Using unqualified chips at 400MHz may result in
        instability or reduced reliability.

choice ESP_DEFAULT_CPU_FREQ_MHZ
    prompt "CPU frequency"
    default ESP_DEFAULT_CPU_FREQ_MHZ_40 if IDF_ENV_FPGA || ESP_BRINGUP_BYPASS_CPU_CLK_SETTING
    default ESP_DEFAULT_CPU_FREQ_MHZ_360 if ESP32P4_SELECTS_REV_LESS_V3
    default ESP_DEFAULT_CPU_FREQ_MHZ_400
    help
        CPU frequency to be set on application startup.

    config ESP_DEFAULT_CPU_FREQ_MHZ_40
        bool "40 MHz"
        depends on IDF_ENV_FPGA || ESP_BRINGUP_BYPASS_CPU_CLK_SETTING
    config ESP_DEFAULT_CPU_FREQ_MHZ_360
        bool "360 MHz"
        depends on ESP32P4_SELECTS_REV_LESS_V3
    config ESP_DEFAULT_CPU_FREQ_MHZ_400
        bool "400 MHz"
        depends on !ESP32P4_SELECTS_REV_LESS_V3 || ESP_FORCE_400MHZ_ON_REV_LESS_V3
endchoice

config ESP_DEFAULT_CPU_FREQ_MHZ
    int
    default 40 if ESP_DEFAULT_CPU_FREQ_MHZ_40
    default 360 if ESP_DEFAULT_CPU_FREQ_MHZ_360
    default 400 if ESP_DEFAULT_CPU_FREQ_MHZ_400
```

## examples/bluetooth/esp_ble_audio/tmap/peripheral/main/Kconfig.projbuild
```kconfig
# SPDX-FileCopyrightText: 2022 Nordic Semiconductor ASA
# SPDX-FileContributor: 2025 Espressif Systems (Shanghai) CO LTD
# SPDX-License-Identifier: Apache-2.0

menu "Example: TMAP Peripheral (CT & UMR)"

    config EXAMPLE_TMAP_PER_SET_RANK
        int "Device rank in set"
        depends on EXAMPLE_TMAP_PER_DUO
        range 1 2
        help
            Rank of this device in set.

    choice EXAMPLE_TMAP_PER_TYPE_CHOICE

        prompt "Earbuds type"
        help
            Select the Earbuds Type to compile.

        config EXAMPLE_TMAP_PER_SINGLE
            bool "Single ear headset"

        config EXAMPLE_TMAP_PER_DUO
            bool "Duo headset"
            select BT_CSIP_SET_MEMBER
            select BT_CAP_ACCEPTOR_SET_MEMBER

    endchoice

    choice EXAMPLE_TMAP_PER_LOCATION

        prompt "Earbud Location"
        help
            Select the Earbud location.

        config EXAMPLE_TMAP_PER_LEFT
            bool "Left Ear"

        config EXAMPLE_TMAP_PER_RIGHT
            bool "Right Ear"

    endchoice

endmenu
```
