## components/esp_driver_touch_sens/test_apps/touch_sens/sdkconfig.defaults.esp32s3
```kconfig
CONFIG_SPIRAM=y
CONFIG_SPIRAM_MALLOC_ALWAYSINTERNAL=0
CONFIG_ULP_COPROC_ENABLED=y
CONFIG_ULP_COPROC_TYPE_RISCV=y
```

## examples/protocols/http_server/ws_echo_server/main/Kconfig.projbuild
```kconfig
menu "Example Configuration"

    config EXAMPLE_ENABLE_WS_PRE_HANDSHAKE_CB
        bool "Enable WebSocket pre-handshake callback"
        select HTTPD_WS_PRE_HANDSHAKE_CB_SUPPORT
        default y
        help
            Enable this option to use WebSocket pre-handshake callback.
            This will allow the server to register a callback function that will be
            called before the WebSocket handshake is processed.

    config EXAMPLE_ENABLE_WS_POST_HANDSHAKE_CB
        bool "Enable WebSocket post-handshake callback"
        select HTTPD_WS_POST_HANDSHAKE_CB_SUPPORT
        default y
        help
            Enable this option to use WebSocket post-handshake callback.
            This will allow the server to register a callback function that will be
            called after the WebSocket handshake is processed.
            In this example, the post-handshake callback is used to send a welcome message
            to the client after the handshake is complete.

    config EXAMPLE_ENABLE_WS_CONTROL_FRAME_HANDLER
        bool "Enable dedicated WebSocket control-frame handler"
        default y
        help
            Enable this option to register a dedicated handler for WebSocket
            control frames (PING, PONG, CLOSE) on the /ws endpoint, keeping them
            out of the data handler. The server receives the frame body for the
            handler, which then sends the protocol replies itself (PONG for
            PING, CLOSE for CLOSE).

endmenu
```
